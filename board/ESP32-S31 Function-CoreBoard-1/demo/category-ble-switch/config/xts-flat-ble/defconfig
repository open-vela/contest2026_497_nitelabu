## workspace/build-configs/esp32s31-xts-flat-audio/defconfig
```kconfig
#
# Initial ESP32-S31 Core Function Board bring-up configuration.
#
# CONFIG_NSH_ARGCAT is not set
# CONFIG_NSH_CMDOPT_HEXDUMP is not set
CONFIG_ARCH="risc-v"
CONFIG_ARCH_BOARD="esp32s31-core-function-board"
CONFIG_ARCH_BOARD_ESP32S31_CORE_FUNCTION_BOARD=y
CONFIG_ARCH_CHIP="esp32s31"
CONFIG_ARCH_CHIP_ESP32S31=y
CONFIG_ARCH_INTERRUPTSTACK=2048
CONFIG_ARCH_RISCV=y
CONFIG_BOARD_LOOPSPERMSEC=15000
CONFIG_BUILTIN=y
CONFIG_ESPRESSIF_CPU_FREQ_320=y
CONFIG_ESPRESSIF_ESP32S31=y
CONFIG_ESPRESSIF_FLASH_16M=y
CONFIG_ESPRESSIF_FLASH_FREQ_80M=y
CONFIG_ESPRESSIF_SIMPLE_BOOT=y
CONFIG_EXPERIMENTAL=y
CONFIG_FS_PROCFS=y
CONFIG_IDLETHREAD_STACKSIZE=2048
CONFIG_INIT_ENTRYPOINT="nsh_main"
CONFIG_INTELHEX_BINARY=y
CONFIG_LIBC_PERROR_STDOUT=y
CONFIG_LIBC_STRERROR=y
CONFIG_NFILE_DESCRIPTORS_PER_BLOCK=6
CONFIG_NSH_BUILTIN_APPS=y
CONFIG_NSH_FILEIOSIZE=512
CONFIG_NSH_READLINE=y
CONFIG_NSH_STRERROR=y
CONFIG_PREALLOC_TIMERS=0
CONFIG_RISCV_TOOLCHAIN_GNU_RV32=y
CONFIG_RR_INTERVAL=200
CONFIG_SCHED_WAITPID=y
CONFIG_START_DAY=11
CONFIG_START_MONTH=8
CONFIG_START_YEAR=2026
CONFIG_SYSTEM_NSH=y
CONFIG_ESPRESSIF_UART0_RXPIN=59
CONFIG_ESPRESSIF_UART0_TXPIN=58
CONFIG_UART0_SERIAL_CONSOLE=y
# CONFIG_ESPRESSIF_BROWNOUT_DET is not set


# Original mm and block tests call internal kernel APIs and require FLAT.
# This is a separate test image, not a replacement for the SMP/MMU demo.
CONFIG_BUILD_FLAT=y
CONFIG_RAM_START=0x2f000000
CONFIG_RAM_SIZE=524288
CONFIG_ARCH_FPU=y
CONFIG_ARCH_SETJMP_H=y
CONFIG_ARCH_STACKDUMP=y
CONFIG_ALLOW_BSD_COMPONENTS=y
CONFIG_ALLOW_MIT_COMPONENTS=y
CONFIG_DEBUG_FEATURES=y
CONFIG_DEBUG_ASSERTIONS=y
CONFIG_DEBUG_ERROR=y
CONFIG_DEBUG_WARN=y
CONFIG_BOARD_LATE_INITIALIZE=y
CONFIG_BOARD_INITTHREAD_STACKSIZE=8192
CONFIG_BOARDCTL_RESET=y
CONFIG_DEFAULT_TASK_STACKSIZE=8192
CONFIG_INIT_STACKSIZE=8192
CONFIG_TLS_LOG2_MAXSTACK=14
CONFIG_LIBC_REGEX=y
CONFIG_LIBC_EXECFUNCS=y
CONFIG_TESTING_CMOCKA=y
CONFIG_TESTING_CMOCKA_STACKSIZE=16384
CONFIG_TESTING_DRIVER_TEST=y
CONFIG_TESTING_DRIVER_TEST_STACKSIZE=8192
CONFIG_TESTING_MM=y
CONFIG_TESTING_MM_STACKSIZE=16384
CONFIG_FS_TMPFS=y
CONFIG_FS_WRITABLE=y
CONFIG_BCH=y
CONFIG_DRVR_WRITEBUFFER=y
CONFIG_DRVR_READAHEAD=y
CONFIG_SCHED_HPWORK=y
CONFIG_SCHED_HPWORKSTACKSIZE=4096
CONFIG_ESPRESSIF_FLASH_MODE_DIO=y
CONFIG_ESPRESSIF_SPIRAM=y
CONFIG_ESPRESSIF_SPIRAM_BOOT_INIT=y
CONFIG_ESPRESSIF_SPIRAM_USE_8LINE_MODE=y
CONFIG_ESPRESSIF_SPIRAM_USER_HEAP=y
CONFIG_MM_REGIONS=2
# CONFIG_NSH_DISABLE_MKRD is not set
# CONFIG_NSH_DISABLE_REBOOT is not set


# All three original RTC tests, including SIGEV_THREAD periodic delivery.
CONFIG_RTC=y
CONFIG_RTC_DRIVER=y
CONFIG_RTC_ALARM=y
CONFIG_RTC_PERIODIC=y
CONFIG_RTC_IOCTL=y
CONFIG_SIG_EVTHREAD=y
CONFIG_SCHED_LPWORK=y
CONFIG_SCHED_LPWORKSTACKSIZE=4096
CONFIG_ESPRESSIF_HR_TIMER_TASK_STACK_SIZE=4096
# CONFIG_RTC_ARCH is not set
# CONFIG_RTC_DATETIME is not set
# CONFIG_TIMER_ARCH is not set


# Isolated half-duplex raw PCM profile for original audio xTS.
CONFIG_ESPRESSIF_I2C0=y
CONFIG_ESPRESSIF_I2C0_SCLPIN=50
CONFIG_ESPRESSIF_I2C0_SDAPIN=51
CONFIG_I2C_RESET=y
CONFIG_AUDIO=y
CONFIG_AUDIO_FORMAT_PCM=y
CONFIG_AUDIO_FORMAT_RAW=y
CONFIG_AUDIO_DRIVER_SPECIFIC_BUFFERS=y
CONFIG_ESP32S31_I2S=y
CONFIG_ESP32S31_AUDIO=y
CONFIG_ES8311_SRC_MCLK=y
CONFIG_ES8311_BUFFER_SIZE=4096
CONFIG_ES8311_NUM_BUFFERS=4
CONFIG_ES8311_WORKER_STACKSIZE=4096
CONFIG_PTHREAD_STACK_MIN=4096
```

## workspace/evidence/backups-2026-09-10-scan-stress/checkpoint1101-flat-audio-mono/source/boards/risc-v/esp32s31/esp32s31-core-function-board/configs/xts-flat-audio/defconfig
```kconfig
#include "../xts-flat-rtc/defconfig"

# Isolated half-duplex raw PCM profile for original audio xTS.
CONFIG_ESPRESSIF_I2C0=y
CONFIG_ESPRESSIF_I2C0_SCLPIN=50
CONFIG_ESPRESSIF_I2C0_SDAPIN=51
CONFIG_I2C_RESET=y
CONFIG_AUDIO=y
CONFIG_AUDIO_FORMAT_PCM=y
CONFIG_AUDIO_FORMAT_RAW=y
CONFIG_AUDIO_DRIVER_SPECIFIC_BUFFERS=y
CONFIG_ESP32S31_I2S=y
CONFIG_ESP32S31_AUDIO=y
CONFIG_ES8311_SRC_MCLK=y
CONFIG_ES8311_RATE_DEPENDENT_MCLK=y
CONFIG_ES8311_BUFFER_SIZE=4096
CONFIG_ES8311_NUM_BUFFERS=4
CONFIG_ES8311_WORKER_STACKSIZE=4096
CONFIG_PTHREAD_STACK_MIN=4096
CONFIG_SYSTEM_NXPLAYER=y
CONFIG_NXPLAYER_MAINTHREAD_STACKSIZE=4096
CONFIG_NXPLAYER_PLAYTHREAD_STACKSIZE=4096
CONFIG_SYSTEM_NXRECORDER=y
CONFIG_NXRECORDER_MAINTHREAD_STACKSIZE=4096
CONFIG_NXRECORDER_RECORDTHREAD_STACKSIZE=4096
CONFIG_SYSTEM_YMODEM=y
CONFIG_SYSTEM_YMODEM_STACKSIZE=4096
```

## workspace/evidence/backups-2026-09-10-scan-stress/checkpoint1679-original-tcp-rx-sack/candidate.defconfig
```kconfig
#include "../demo-rmt-bttool-coex-pie-netdiag/defconfig"
CONFIG_NET_TCP_SELECTIVE_ACK=y
CONFIG_NET_TCP_OUT_OF_ORDER=y
CONFIG_NET_TCP_OUT_OF_ORDER_BUFSIZE=16384
```

## workspace/evidence/backups-2026-09-10-scan-stress/checkpoint916/defconfig
```kconfig
#include "../xts-flat-rtc/defconfig"

# Isolated half-duplex raw PCM profile for original audio xTS.
CONFIG_ESPRESSIF_I2C0=y
CONFIG_ESPRESSIF_I2C0_SCLPIN=50
CONFIG_ESPRESSIF_I2C0_SDAPIN=51
CONFIG_I2C_RESET=y
CONFIG_AUDIO=y
CONFIG_AUDIO_FORMAT_PCM=y
CONFIG_AUDIO_FORMAT_RAW=y
CONFIG_AUDIO_DRIVER_SPECIFIC_BUFFERS=y
CONFIG_ESP32S31_I2S=y
CONFIG_ESP32S31_AUDIO=y
CONFIG_ES8311_SRC_MCLK=y
CONFIG_ES8311_BUFFER_SIZE=4096
CONFIG_ES8311_NUM_BUFFERS=4
CONFIG_ES8311_WORKER_STACKSIZE=4096
CONFIG_PTHREAD_STACK_MIN=4096
```

## workspace/evidence/backups-2026-09-10-scan-stress/checkpoint987-flat-media-volume/source/openvela-dev/nuttx/boards/risc-v/esp32s31/esp32s31-core-function-board/configs/xts-flat-media/defconfig
```kconfig
#include "../xts-flat-audio-duplex/defconfig"

# Original mediatool audio tests on one local CPU; no radio or provisioning.
CONFIG_ES8311_PCM_CAPS=y
CONFIG_EVENT_FD=y
CONFIG_NET=y
CONFIG_NETDEV_LATEINIT=y
CONFIG_NET_IPv4=n
CONFIG_NET_IPv6=n
CONFIG_NET_LOCAL=y
CONFIG_NET_LOCAL_STREAM=y
CONFIG_NET_LOCAL_NONBLOCKING=y
CONFIG_NET_SOCKOPTS=y
CONFIG_NET_NSOCKET_DESCRIPTORS=32
CONFIG_MEDIA=y
CONFIG_MEDIA_SERVER=y
CONFIG_MEDIA_GRAPH=y
CONFIG_MEDIA_TOOL=y
CONFIG_MEDIA_POLICY=y
CONFIG_MEDIA_SERVER_CPUNAME="local"
CONFIG_MEDIA_SERVER_CONFIG_PATH="/data/media/"
CONFIG_MEDIA_PLAYER_MAX_CNT=1
CONFIG_MEDIA_RECORDER_MAX_CNT=1
CONFIG_LIB_PFW=y
CONFIG_LIB_PFW_DEBUG=n
CONFIG_KVDB=y
CONFIG_KVDB_DIRECT=y
CONFIG_KVDB_FILE=y
CONFIG_KVDB_PERSIST_PATH="/tmp/media-kv"
CONFIG_KVDB_TEMPORARY_STORAGE=n
CONFIG_AUDIOUTILS_ALSA_LIB=y
CONFIG_AUDIOUTILS_ALSA_LIB_DEVICE_HW=y
CONFIG_LIB_FFMPEG=y
CONFIG_LIB_FFMPEG_AUDIO_TABLEGEN=y
CONFIG_LIB_FFMPEG_CONFIGURATION="--disable-asm --disable-inline-asm --disable-rvv --disable-tx-double --disable-tx-int32 --enable-avcodec --enable-avdevice --enable-avfilter --enable-avformat --enable-swresample --enable-alsa --enable-decoder='aac,mp3float,opus,pcm_s16le' --enable-demuxer='aac,mov,mp3,ogg,wav' --enable-parser='aac,mpegaudio,opus' --enable-filter='abufsrc,asubgraph,abuffer,abuffersink,aresample,alsasink' --enable-protocol=file --enable-hardcoded-tables"
```
