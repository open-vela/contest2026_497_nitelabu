## board/ESP32-S31 Function-CoreBoard-1/demo/common-1.1.7/config/demo-rmt/defconfig
```kconfig
#include "../demo-i2c/defconfig"
CONFIG_RMT=y
CONFIG_ESP_RMT=y
CONFIG_WS2812=y
CONFIG_WS2812_NON_SPI_DRIVER=y
CONFIG_WS2812_LED_COUNT=1
CONFIG_DEBUG_RMT=y
CONFIG_DEBUG_RMT_ERROR=y
CONFIG_EXAMPLES_S31LED=y
```

## board/ESP32-S31 Function-CoreBoard-1/demo/rgb565-display/src/apps/examples/s31rgb565/Kconfig
```kconfig
# SPDX-License-Identifier: Apache-2.0

config EXAMPLES_S31RGB565
	tristate "ESP32-S31 Korvo RGB565 framebuffer demo"
	default n
	depends on VIDEO_FB && FB_UPDATE
	---help---
		Draw an openvela RGB565 dashboard, solid colors, and a pixel grid
		on an 800x480 framebuffer. The driver must synchronize scanout in
		FBIO_UPDATE before the application redraws the mapped buffer.
		The pattern cycle lasts 30 seconds. Use --frames N or --cycles N
		for a finite run; otherwise the program runs continuously.

if EXAMPLES_S31RGB565

config EXAMPLES_S31RGB565_PROGNAME
	string "Program name"
	default "s31rgb565"

config EXAMPLES_S31RGB565_PRIORITY
	int "Task priority"
	default 100

config EXAMPLES_S31RGB565_STACKSIZE
	int "Stack size"
	default 4096

endif
```

## workspace/build-configs/esp32s31-cmake-demo/defconfig
```kconfig
# I2C0 board control-bus validation; keep the ordinary demo recoverable.
#
# ESP32-S31 basic LAN demo: NSH, b/g/n Wi-Fi and a read-only status page.
#

# CONFIG_ESP32S31_FLASH_APPFS_SEED_INSTALL is not set
# CONFIG_ESPRESSIF_BROWNOUT_DET is not set
# CONFIG_ESPRESSIF_SPIRAM_MEMTEST is not set
# CONFIG_ESPRESSIF_SPIRAM_USER_HEAP is not set
# CONFIG_ESPRESSIF_WIFI_ENABLE_SAE_H2E is not set
# CONFIG_ESPRESSIF_WIFI_ENABLE_SAE_PK is not set
# CONFIG_ESPRESSIF_WIFI_ENABLE_WPA3_OWE_STA is not set
# CONFIG_ESPRESSIF_WIFI_ENABLE_WPA3_SAE is not set
# CONFIG_NSH_ARGCAT is not set
# CONFIG_NSH_CMDOPT_HEXDUMP is not set
CONFIG_ALLOW_BSD_COMPONENTS=y
CONFIG_ARCH_BUTTONS=y
CONFIG_ARCH_IRQBUTTONS=y
CONFIG_ESPRESSIF_GPIO_IRQ=y
CONFIG_INPUT=y
CONFIG_INPUT_BUTTONS=y
CONFIG_INPUT_BUTTONS_LOWER=y
CONFIG_INPUT_BUTTONS_DEBOUNCE_DELAY=20
CONFIG_EXAMPLES_BUTTONS=y
CONFIG_EXAMPLES_BUTTONS_POLL=y
CONFIG_ARCH="risc-v"
CONFIG_ARCH_ADDRENV=y
CONFIG_ARCH_BOARD="esp32s31-core-function-board"
CONFIG_ARCH_BOARD_ESP32S31_CORE_FUNCTION_BOARD=y
CONFIG_ARCH_CHIP="esp32s31"
CONFIG_ARCH_CHIP_ESP32S31=y
CONFIG_ARCH_DATA_NPAGES=256
CONFIG_ARCH_DATA_VBASE=0x61400000
CONFIG_ARCH_FPU=y
CONFIG_ARCH_HEAP_NPAGES=128
CONFIG_ARCH_HEAP_VBASE=0x61800000
CONFIG_ARCH_INTERRUPTSTACK=2048
CONFIG_ARCH_IRQ_TO_NDX=y
CONFIG_ARCH_KERNEL_STACKSIZE=3072
CONFIG_ARCH_MINIMAL_VECTORTABLE_DYNAMIC=y
CONFIG_ARCH_NUSER_INTERRUPTS=17
CONFIG_ARCH_PGPOOL_MAPPING=y
CONFIG_ARCH_PGPOOL_PBASE=0x50000000
CONFIG_ARCH_PGPOOL_SIZE=16777216
CONFIG_ARCH_PGPOOL_VBASE=0x50000000
CONFIG_ARCH_RISCV=y
CONFIG_ARCH_RISCV_INTXCPT_EXTENSIONS=y
CONFIG_ARCH_RISCV_INTXCPT_EXTREGS=1
CONFIG_ARCH_STACKDUMP=y
CONFIG_ARCH_TEXT_NPAGES=256
CONFIG_ARCH_TEXT_VBASE=0x61000000
CONFIG_ARCH_USE_MMU=y
CONFIG_ARCH_USE_MPU=y
CONFIG_ARCH_USE_S_MODE=y
CONFIG_BINFMT_ELF_EXECUTABLE=y
CONFIG_BOARD_LATE_INITIALIZE=y
CONFIG_BOARD_INITTHREAD_STACKSIZE=8192
CONFIG_BOARD_LOOPSPERMSEC=15000
CONFIG_BUILD_KERNEL=y
CONFIG_CRYPTO_MBEDTLS=y
CONFIG_DEBUG_ASSERTIONS=y
CONFIG_DEBUG_FEATURES=y
CONFIG_DEBUG_NET=y
CONFIG_DEBUG_NET_ERROR=y
CONFIG_DEBUG_WIRELESS=y
CONFIG_DEBUG_WIRELESS_ERROR=y
CONFIG_DEV_URANDOM=y
CONFIG_DRIVERS_IEEE80211=y
CONFIG_DRIVERS_WIRELESS=y
CONFIG_ELF=y
CONFIG_ELF_APP_MAX_FILESIZE=524288
CONFIG_ELF_APP_VERIFY=y
CONFIG_ESP32S31_CPU1_BOOT_STACKSIZE=1024
CONFIG_ESP32S31_CPU1_BOOT_TIMEOUT_US=500000
CONFIG_ESP32S31_FLASH_APPFS=y
CONFIG_ESP32S31_FLASH_APPFS_SEED_SIZE=0x300000
CONFIG_ESP32S31_SMP=y
CONFIG_ESP32S31_SMP_TLB_SHOOTDOWN=y
CONFIG_ESP32S31_SMP_TLB_SHOOTDOWN_TIMEOUT_US=500000
CONFIG_ESPRESSIF_CPU_FREQ_320=y
CONFIG_ESPRESSIF_ESP32S31=y
CONFIG_ESPRESSIF_FLASH_16M=y
CONFIG_ESPRESSIF_FLASH_FREQ_80M=y
CONFIG_ESPRESSIF_FLASH_MODE_DIO=y
CONFIG_ESPRESSIF_SIMPLE_BOOT=y
CONFIG_ESPRESSIF_SPIFLASH_MTD_BLKSIZE=512
CONFIG_ESPRESSIF_SPIRAM=y
CONFIG_ESPRESSIF_SPIRAM_BOOT_INIT=y
CONFIG_ESPRESSIF_SPIRAM_SPEED_80M=y
CONFIG_ESPRESSIF_SPIRAM_USE_8LINE_MODE=y
CONFIG_ESPRESSIF_STORAGE_MTD_OFFSET=0x200000
CONFIG_ESPRESSIF_STORAGE_MTD_SIZE=0xa00000
CONFIG_ESPRESSIF_UART0_RXPIN=59
CONFIG_ESPRESSIF_UART0_TXPIN=58
CONFIG_ESPRESSIF_WIFI=y
CONFIG_ESPRESSIF_WIFI_STATION=y
CONFIG_EXPERIMENTAL=y
CONFIG_FS_LITTLEFS=y
CONFIG_FS_PROCFS=y
CONFIG_FS_ROMFS=y
CONFIG_FS_TMPFS=y
CONFIG_IDLETHREAD_STACKSIZE=3072
CONFIG_INIT_FILEPATH="/system/bin/init"
CONFIG_INIT_STACKSIZE=4096
CONFIG_INTELHEX_BINARY=y
CONFIG_IOB_BUFSIZE=400
CONFIG_IOB_NBUFFERS=96
CONFIG_IOB_NCHAINS=32
CONFIG_IOB_THROTTLE=24
CONFIG_LIBC_ENVPATH=y
CONFIG_LIBC_EXECFUNCS=y
CONFIG_LIBC_PERROR_STDOUT=y
CONFIG_LIBC_STRERROR=y
CONFIG_MBEDTLS_HAVE_TIME_DATE=y
CONFIG_MBEDTLS_VERSION="3.6.4"
CONFIG_MM_PGALLOC=y
CONFIG_NETDB_DNSCLIENT=y
CONFIG_NETDB_RESOLVCONF=y
CONFIG_NETDB_RESOLVCONF_PATH="/tmp/resolv.conf"
CONFIG_NETDEV_LATEINIT=y
CONFIG_NETDEV_PHY_IOCTL=y
CONFIG_NETDEV_WIRELESS_IOCTL=y
CONFIG_NETUTILS_WEBCLIENT=y
CONFIG_NET_BROADCAST=y
CONFIG_NET_ETH_PKTSIZE=1514
CONFIG_NET_ICMP_SOCKET=y
CONFIG_NET_SOCKOPTS=y
CONFIG_NET_TCP=y
CONFIG_NET_TCP_DELAYED_ACK=y
CONFIG_NET_TCP_KEEPALIVE=y
CONFIG_NET_TCP_WRITE_BUFFERS=y
CONFIG_NET_UDP=y
CONFIG_NET_UDP_CHECKSUMS=y
CONFIG_NET_UDP_WRITE_BUFFERS=y
CONFIG_NFILE_DESCRIPTORS_PER_BLOCK=6
CONFIG_NSH_FILE_APPS=y
CONFIG_NSH_FILEIOSIZE=512
CONFIG_NSH_QUOTE=y
CONFIG_NSH_READLINE=y
CONFIG_NSH_STRERROR=y
CONFIG_PATH_INITIAL="/apps:/system/bin"
CONFIG_PREALLOC_TIMERS=0
CONFIG_PTHREAD_MUTEX_TYPES=y
CONFIG_RAM_SIZE=524288
CONFIG_RAM_START=0x2f000000
CONFIG_RAM_VSTART=0x2f000000
CONFIG_READLINE_CMD_HISTORY=y
CONFIG_RISCV_TOOLCHAIN_GNU_RV32=y
CONFIG_RR_INTERVAL=20
CONFIG_RTC=y
CONFIG_RTC_DRIVER=y
CONFIG_SCHED_HAVE_PARENT=y
CONFIG_SCHED_LPWORK=y
CONFIG_SCHED_BACKTRACE=y
CONFIG_SCHED_WAITPID=y
CONFIG_SIG_DEFAULT=y
CONFIG_SMP=y
CONFIG_SMP_DEFAULT_CPUSET=0x3
CONFIG_SMP_NCPUS=2
CONFIG_START_DAY=6
CONFIG_START_MONTH=9
CONFIG_START_YEAR=2026
CONFIG_SYSTEM_DHCPC_RENEW=y
CONFIG_SYSTEM_NSH=y
CONFIG_SYSTEM_NSH_PRIORITY=101
CONFIG_SYSTEM_NSH_PROGNAME="init"
CONFIG_SYSTEM_PING=y
CONFIG_TLS_NELEM=4
CONFIG_UART0_SERIAL_CONSOLE=y
CONFIG_WIRELESS=y
CONFIG_WIRELESS_WAPI=y
CONFIG_WIRELESS_WAPI_CMDTOOL=y
CONFIG_WIRELESS_WAPI_INITCONF=y

# Keep the demo on the validated compatibility path; HE remains under test.
# CONFIG_ESPRESSIF_WIFI_STA_11AX is not set
CONFIG_NETINIT_IPADDR=0x00000000
CONFIG_EXAMPLES_S31DEMO=y
CONFIG_EXAMPLES_S31DEMO_STACKSIZE=8192
CONFIG_EXAMPLES_NETTEST=y
CONFIG_EXAMPLES_NETTEST_SERVER=y
CONFIG_EXAMPLES_NETTEST_SENDSIZE=4096
# CONFIG_EXAMPLES_NETTEST_INIT is not set
CONFIG_EXAMPLES_UDP=y
CONFIG_EXAMPLES_UDP_SERVER1=y
# CONFIG_EXAMPLES_UDP_NETINIT is not set

CONFIG_ESPRESSIF_I2C0=y
CONFIG_ESPRESSIF_I2C0_SCLPIN=50
CONFIG_ESPRESSIF_I2C0_SDAPIN=51
CONFIG_I2C_RESET=y
CONFIG_SYSTEM_I2CTOOL=y
CONFIG_I2CTOOL_MAXBUS=0
CONFIG_I2CTOOL_DEFFREQ=100000
```

## workspace/build-configs/esp32s31-cmake-smp2/defconfig
```kconfig
#
# ESP32-S31 dual-core supervisor-mode bring-up configuration.
#
# This profile intentionally omits Wi-Fi and external AppFS.  It packages the
# user-mode NSH image in ROMFS so SMP, Sv32 and PSRAM can be validated before
# storage and network dependencies are introduced.
#

# CONFIG_NSH_ARGCAT is not set
# CONFIG_NSH_CMDOPT_HEXDUMP is not set
CONFIG_ARCH="risc-v"
CONFIG_ARCH_ADDRENV=y
CONFIG_ARCH_BOARD="esp32s31-core-function-board"
CONFIG_ARCH_BOARD_ESP32S31_CORE_FUNCTION_BOARD=y
CONFIG_ARCH_CHIP="esp32s31"
CONFIG_ARCH_CHIP_ESP32S31=y
CONFIG_ARCH_DATA_NPAGES=256
CONFIG_ARCH_DATA_VBASE=0x61400000
CONFIG_ARCH_FPU=y
CONFIG_ARCH_HEAP_NPAGES=128
CONFIG_ARCH_HEAP_VBASE=0x61800000
CONFIG_ARCH_INTERRUPTSTACK=2048
CONFIG_ARCH_IRQ_TO_NDX=y
CONFIG_ARCH_KERNEL_STACKSIZE=3072
CONFIG_ARCH_MINIMAL_VECTORTABLE_DYNAMIC=y
CONFIG_ARCH_NUSER_INTERRUPTS=17
CONFIG_ARCH_PGPOOL_MAPPING=y
CONFIG_ARCH_PGPOOL_PBASE=0x50000000
CONFIG_ARCH_PGPOOL_SIZE=16777216
CONFIG_ARCH_PGPOOL_VBASE=0x50000000
CONFIG_ARCH_RISCV=y
CONFIG_ARCH_RISCV_INTXCPT_EXTENSIONS=y
CONFIG_ARCH_RISCV_INTXCPT_EXTREGS=1
CONFIG_ARCH_TEXT_NPAGES=256
CONFIG_ARCH_TEXT_VBASE=0x61000000
CONFIG_ARCH_USE_MMU=y
CONFIG_ARCH_USE_MPU=y
CONFIG_ARCH_USE_S_MODE=y
CONFIG_BINFMT_ELF_EXECUTABLE=y
CONFIG_BOARD_LATE_INITIALIZE=y
CONFIG_BOARD_INITTHREAD_STACKSIZE=8192
CONFIG_BOARD_LOOPSPERMSEC=15000
CONFIG_BUILD_KERNEL=y
CONFIG_ELF=y
CONFIG_ELF_APP_MAX_FILESIZE=524288
CONFIG_EXPERIMENTAL=y
CONFIG_ESP32S31_CPU1_BOOT_STACKSIZE=1024
CONFIG_ESP32S31_CPU1_BOOT_TIMEOUT_US=500000
CONFIG_ESP32S31_SMP=y
CONFIG_ESP32S31_SMP_TLB_SHOOTDOWN=y
CONFIG_ESP32S31_SMP_TLB_SHOOTDOWN_TIMEOUT_US=500000
CONFIG_ESPRESSIF_CPU_FREQ_320=y
CONFIG_ESPRESSIF_ESP32S31=y
CONFIG_ESPRESSIF_FLASH_16M=y
CONFIG_ESPRESSIF_FLASH_FREQ_80M=y
CONFIG_ESPRESSIF_FLASH_MODE_DIO=y
CONFIG_ESPRESSIF_SIMPLE_BOOT=y
CONFIG_ESPRESSIF_SPIRAM=y
CONFIG_ESPRESSIF_SPIRAM_BOOT_INIT=y
# CONFIG_ESPRESSIF_SPIRAM_MEMTEST is not set
CONFIG_ESPRESSIF_SPIRAM_SPEED_80M=y
CONFIG_ESPRESSIF_SPIRAM_USE_8LINE_MODE=y
# CONFIG_ESPRESSIF_SPIRAM_USER_HEAP is not set
CONFIG_ESPRESSIF_UART0_RXPIN=59
CONFIG_ESPRESSIF_UART0_TXPIN=58
CONFIG_FS_PROCFS=y
CONFIG_FS_ROMFS=y
CONFIG_IDLETHREAD_STACKSIZE=3072
CONFIG_INIT_FILEPATH="/system/bin/init"
CONFIG_INIT_MOUNT=y
CONFIG_INIT_MOUNT_FLAGS=0x1
CONFIG_INIT_MOUNT_FSTYPE="romfs"
CONFIG_INIT_MOUNT_SOURCE="/dev/ram0"
CONFIG_INIT_MOUNT_TARGET="/system/bin"
CONFIG_INIT_STACKSIZE=4096
CONFIG_INTELHEX_BINARY=y
CONFIG_LIBC_ENVPATH=y
CONFIG_LIBC_EXECFUNCS=y
CONFIG_LIBC_PERROR_STDOUT=y
CONFIG_LIBC_STRERROR=y
CONFIG_MM_PGALLOC=y
CONFIG_NFILE_DESCRIPTORS_PER_BLOCK=6
CONFIG_NSH_FILE_APPS=y
CONFIG_NSH_FILEIOSIZE=512
CONFIG_NSH_QUOTE=y
CONFIG_NSH_READLINE=y
CONFIG_NSH_STRERROR=y
CONFIG_PATH_INITIAL="/system/bin"
CONFIG_PREALLOC_TIMERS=0
CONFIG_RAM_SIZE=524288
CONFIG_RAM_START=0x2f000000
CONFIG_RAM_VSTART=0x2f000000
CONFIG_READLINE_CMD_HISTORY=y
CONFIG_RISCV_TOOLCHAIN_GNU_RV32=y
CONFIG_RR_INTERVAL=20
CONFIG_SCHED_HAVE_PARENT=y
CONFIG_SCHED_LPWORK=y
CONFIG_SCHED_WAITPID=y
CONFIG_SIG_DEFAULT=y
CONFIG_SMP=y
CONFIG_SMP_DEFAULT_CPUSET=0x3
CONFIG_SMP_NCPUS=2
CONFIG_START_DAY=6
CONFIG_START_MONTH=9
CONFIG_START_YEAR=2026
CONFIG_SYSTEM_NSH=y
CONFIG_SYSTEM_NSH_PRIORITY=101
CONFIG_SYSTEM_NSH_PROGNAME="init"
CONFIG_UART0_SERIAL_CONSOLE=y
# CONFIG_ESPRESSIF_BROWNOUT_DET is not set
```

## workspace/build-configs/esp32s31-cmake-wifi-flat184/defconfig
```kconfig
# Isolated M-mode Wi-Fi diagnostic; does not mount or seed Flash AppFS.
#
# Initial ESP32-S31 Core Function Board bring-up configuration.
#
# CONFIG_NSH_ARGCAT is not set
# CONFIG_NSH_CMDOPT_HEXDUMP is not set
CONFIG_ARCH="risc-v"
CONFIG_ARCH_BOARD="esp32s31-core-function-board"
CONFIG_ARCH_BOARD_ESP32S31_CORE_FUNCTION_BOARD=y
CONFIG_ARCH_CHIP="esp32s31"
CONFIG_ARCH_CHIP_ESP32S31=y
CONFIG_ARCH_INTERRUPTSTACK=2048
CONFIG_ARCH_RISCV=y
CONFIG_BOARD_LOOPSPERMSEC=15000
CONFIG_BUILTIN=y
CONFIG_ESPRESSIF_CPU_FREQ_320=y
CONFIG_ESPRESSIF_ESP32S31=y
CONFIG_ESPRESSIF_FLASH_16M=y
CONFIG_ESPRESSIF_FLASH_FREQ_80M=y
CONFIG_ESPRESSIF_SIMPLE_BOOT=y
CONFIG_EXPERIMENTAL=y
CONFIG_FS_PROCFS=y
CONFIG_IDLETHREAD_STACKSIZE=2048
CONFIG_INIT_ENTRYPOINT="nsh_main"
CONFIG_INTELHEX_BINARY=y
CONFIG_LIBC_PERROR_STDOUT=y
CONFIG_LIBC_STRERROR=y
CONFIG_NFILE_DESCRIPTORS_PER_BLOCK=6
CONFIG_NSH_BUILTIN_APPS=y
CONFIG_NSH_FILEIOSIZE=512
CONFIG_NSH_READLINE=y
CONFIG_NSH_STRERROR=y
CONFIG_PREALLOC_TIMERS=0
CONFIG_RISCV_TOOLCHAIN_GNU_RV32=y
CONFIG_RR_INTERVAL=200
CONFIG_SCHED_WAITPID=y
CONFIG_START_DAY=11
CONFIG_START_MONTH=8
CONFIG_START_YEAR=2026
CONFIG_SYSTEM_NSH=y
CONFIG_ESPRESSIF_UART0_RXPIN=59
CONFIG_ESPRESSIF_UART0_TXPIN=58
CONFIG_UART0_SERIAL_CONSOLE=y
# CONFIG_ESPRESSIF_BROWNOUT_DET is not set

CONFIG_ALLOW_BSD_COMPONENTS=y
CONFIG_ARCH_FPU=y
CONFIG_ARCH_STACKDUMP=y
CONFIG_BOARD_LATE_INITIALIZE=y
CONFIG_BOARD_INITTHREAD_STACKSIZE=8192
CONFIG_CRYPTO_MBEDTLS=y
CONFIG_DEBUG_ASSERTIONS=y
CONFIG_DEBUG_FEATURES=y
CONFIG_DEBUG_NET=y
CONFIG_DEBUG_NET_ERROR=y
CONFIG_DEBUG_WIRELESS=y
CONFIG_DEBUG_WIRELESS_ERROR=y
CONFIG_DEV_URANDOM=y
CONFIG_DRIVERS_IEEE80211=y
CONFIG_DRIVERS_WIRELESS=y
CONFIG_ESPRESSIF_FLASH_MODE_DIO=y
CONFIG_ESPRESSIF_WIFI=y
CONFIG_ESPRESSIF_WIFI_STATION=y
CONFIG_ESPRESSIF_WIFI_STA_11AX=y
# CONFIG_ESPRESSIF_WIFI_ENABLE_WPA3_SAE is not set
# CONFIG_ESPRESSIF_WIFI_ENABLE_WPA3_OWE_STA is not set
# CONFIG_ESPRESSIF_WIFI_ENABLE_SAE_H2E is not set
# CONFIG_ESPRESSIF_WIFI_ENABLE_SAE_PK is not set
CONFIG_EXAMPLES_NETTEST=y
CONFIG_EXAMPLES_NETTEST_SENDSIZE=4096
CONFIG_EXAMPLES_NETTEST_SERVER=y
# CONFIG_EXAMPLES_NETTEST_INIT is not set
CONFIG_FS_TMPFS=y
CONFIG_IDLETHREAD_STACKSIZE=3072
CONFIG_INIT_STACKSIZE=4096
CONFIG_IOB_BUFSIZE=400
CONFIG_IOB_NBUFFERS=96
CONFIG_IOB_NCHAINS=32
CONFIG_IOB_THROTTLE=24
CONFIG_MBEDTLS_HAVE_TIME_DATE=y
CONFIG_MBEDTLS_VERSION="3.6.4"
CONFIG_NETDB_DNSCLIENT=y
CONFIG_NETDB_RESOLVCONF=y
CONFIG_NETDB_RESOLVCONF_PATH="/tmp/resolv.conf"
CONFIG_NETDEV_LATEINIT=y
CONFIG_NETDEV_PHY_IOCTL=y
CONFIG_NETDEV_WIRELESS_IOCTL=y
CONFIG_NET_BROADCAST=y
CONFIG_NET_ETH_PKTSIZE=1514
CONFIG_NET_ICMP_SOCKET=y
CONFIG_NET_SOCKOPTS=y
CONFIG_NET_TCP=y
CONFIG_NET_TCP_DELAYED_ACK=y
CONFIG_NET_TCP_KEEPALIVE=y
CONFIG_NET_TCP_WRITE_BUFFERS=y
CONFIG_NET_UDP=y
CONFIG_NET_UDP_CHECKSUMS=y
CONFIG_NET_UDP_WRITE_BUFFERS=y
CONFIG_NSH_QUOTE=y
CONFIG_PTHREAD_MUTEX_TYPES=y
CONFIG_RAM_SIZE=524288
CONFIG_RAM_START=0x2f000000
CONFIG_RAM_VSTART=0x2f000000
CONFIG_READLINE_CMD_HISTORY=y
CONFIG_RR_INTERVAL=20
CONFIG_RTC=y
CONFIG_RTC_DRIVER=y
CONFIG_SCHED_HAVE_PARENT=y
CONFIG_SCHED_LPWORK=y
CONFIG_SCHED_BACKTRACE=y
CONFIG_SIG_DEFAULT=y
CONFIG_SYSTEM_DHCPC_RENEW=y
CONFIG_SYSTEM_NSH_PRIORITY=101
CONFIG_SYSTEM_PING=y
CONFIG_TLS_NELEM=4
CONFIG_WIRELESS=y
CONFIG_WIRELESS_WAPI=y
CONFIG_WIRELESS_WAPI_CMDTOOL=y
CONFIG_WIRELESS_WAPI_INITCONF=y
```
