## board/ESP32-S31 Function-CoreBoard-1 + ESP32-S31 Korvo-1/demo/camera-ov3660/src/apps/examples/s31preview/Kconfig
```kconfig
# SPDX-License-Identifier: Apache-2.0

config EXAMPLES_S31PREVIEW
	tristate "ESP32-S31 camera to framebuffer preview"
	default n
	depends on ESP32S31_CAMERA_V4L2 && VIDEO_FB && FB_UPDATE
	---help---
		Capture real 640x480 RGB565 USERPTR frames from /dev/video0 and
		present them centered on an 800x480 RGB565 /dev/fb0 framebuffer.
		The default run displays 60 frames with a finite capture timeout.

if EXAMPLES_S31PREVIEW

config EXAMPLES_S31PREVIEW_PROGNAME
	string "Program name"
	default "s31preview"

config EXAMPLES_S31PREVIEW_PRIORITY
	int "Task priority"
	default 100

config EXAMPLES_S31PREVIEW_STACKSIZE
	int "Stack size"
	default 8192

endif
```

## board/ESP32-S31 Function-CoreBoard-1 + ESP32-S31 Korvo-1/demo/category-5.1.5/config/xts-flat-category-fs/defconfig
```kconfig
#include "../xts-flat-rtc/defconfig"

# Published filesystem cases; mount disposable test volumes explicitly.
CONFIG_FS_ROMFS=y
CONFIG_BOARDCTL_ROMDISK=y
CONFIG_EXAMPLES_ROMFS=y
CONFIG_FS_FAT=y
CONFIG_FAT_LFN=y
CONFIG_FAT_LFN_UTF8=y
CONFIG_TESTING_FATUTF8=y
CONFIG_TESTING_FATUTF8_STACKSIZE=8192
CONFIG_FSUTILS_MKFATFS=y
CONFIG_TESTS_TESTCASES=y
CONFIG_TESTING_TESTCASES_STACKSIZE=32768
CONFIG_FS_TEST=y
CONFIG_FS_TEST_STRESS=y
CONFIG_FS_TEST_STABILITY=y
CONFIG_PSEUDOFS_SOFTLINKS=y
CONFIG_TESTING_FSTEST=y
CONFIG_TESTING_FSTEST_MAXFILE=32768
```

## board/ESP32-S31 Function-CoreBoard-1 + ESP32-S31 Korvo-1/demo/common-1.3.6/config/demo-gpio-loopback/defconfig
```kconfig
#include "../demo-rmt-bttool-coex-pie-netdiag-sack-window128-ampdu12/defconfig"
CONFIG_DEV_GPIO=y
CONFIG_ESP32S31_XTS_GPIO=y
CONFIG_LIBC_REGEX=y
CONFIG_TESTING_CMOCKA=m
CONFIG_TESTING_DRIVER_TEST=m
CONFIG_TESTING_DRIVER_TEST_STACKSIZE=8192
CONFIG_TESTING_DRIVER_TEST_SIMPLE=n
CONFIG_TESTING_DRIVER_GPIO=y
CONFIG_TESTING_DRIVER_GPIO_INPUT_PIN="/dev/gpio0"
CONFIG_TESTING_DRIVER_GPIO_OUTPUT_PIN="/dev/gpio1"
CONFIG_TESTING_DRIVER_GPIO_LOOP=1
CONFIG_TESTING_DRIVER_GPIO_INTERRUPT_TYPE=1
CONFIG_ALLOW_MIT_COMPONENTS=y
CONFIG_UTILS_IPERF2=n
CONFIG_ARCH_SETJMP_H=y
CONFIG_UTILS_CURL=n
```

## board/ESP32-S31 Function-CoreBoard-1 + ESP32-S31 Korvo-1/demo/i2c-c6/c6/sdkconfig.defaults
```kconfig
CONFIG_IDF_TARGET="esp32c6"
CONFIG_I2C_SLAVE_SCL_GPIO=4
CONFIG_I2C_SLAVE_SDA_GPIO=5
CONFIG_I2C_SLAVE_ADDRESS=104
```

## board/ESP32-S31 Function-CoreBoard-1 + ESP32-S31 Korvo-1/demo/i2c-c6/config/nsh/defconfig
```kconfig
#
# Initial ESP32-S31 Core Function Board bring-up configuration.
#
# CONFIG_NSH_ARGCAT is not set
# CONFIG_NSH_CMDOPT_HEXDUMP is not set
CONFIG_ARCH="risc-v"
CONFIG_ARCH_BOARD="esp32s31-core-function-board"
CONFIG_ARCH_BOARD_ESP32S31_CORE_FUNCTION_BOARD=y
CONFIG_ARCH_CHIP="esp32s31"
CONFIG_ARCH_CHIP_ESP32S31=y
CONFIG_ARCH_INTERRUPTSTACK=2048
CONFIG_ARCH_RISCV=y
CONFIG_BOARD_LOOPSPERMSEC=15000
CONFIG_BUILTIN=y
CONFIG_ESPRESSIF_CPU_FREQ_320=y
CONFIG_ESPRESSIF_ESP32S31=y
CONFIG_ESPRESSIF_FLASH_16M=y
CONFIG_ESPRESSIF_FLASH_FREQ_80M=y
CONFIG_ESPRESSIF_SIMPLE_BOOT=y
CONFIG_EXPERIMENTAL=y
CONFIG_FS_PROCFS=y
CONFIG_IDLETHREAD_STACKSIZE=2048
CONFIG_INIT_ENTRYPOINT="nsh_main"
CONFIG_INTELHEX_BINARY=y
CONFIG_LIBC_PERROR_STDOUT=y
CONFIG_LIBC_STRERROR=y
CONFIG_NFILE_DESCRIPTORS_PER_BLOCK=6
CONFIG_NSH_BUILTIN_APPS=y
CONFIG_NSH_FILEIOSIZE=512
CONFIG_NSH_READLINE=y
CONFIG_NSH_STRERROR=y
CONFIG_PREALLOC_TIMERS=0
CONFIG_RISCV_TOOLCHAIN_GNU_RV32=y
CONFIG_RR_INTERVAL=200
CONFIG_SCHED_WAITPID=y
CONFIG_START_DAY=11
CONFIG_START_MONTH=8
CONFIG_START_YEAR=2026
CONFIG_SYSTEM_NSH=y
CONFIG_ESPRESSIF_UART0_RXPIN=59
CONFIG_ESPRESSIF_UART0_TXPIN=58
CONFIG_UART0_SERIAL_CONSOLE=y
# CONFIG_ESPRESSIF_BROWNOUT_DET is not set
```

## board/ESP32-S31 Function-CoreBoard-1 + ESP32-S31 Korvo-1/demo/jpeg-rgb/src/jpegtest/Kconfig
```kconfig
#
# JPEG/RGB software smoke test for the S31 board.
#

config EXAMPLES_JPEGTEST
	tristate "JPEG and RGB pixel-format test"
	default n
	depends on LIB_JPEG_TURBO
	---help---
		Enable the jpegtest command.  It encodes a small RGB888 image,
		decodes it as RGB565, and checks the RGB565 packing helpers.

if EXAMPLES_JPEGTEST

config EXAMPLES_JPEGTEST_PROGNAME
	string "Program name"
	default "jpegtest"

config EXAMPLES_JPEGTEST_PRIORITY
	int "Task priority"
	default 100

config EXAMPLES_JPEGTEST_STACKSIZE
	int "Task stack size"
	default 8192

endif
```
