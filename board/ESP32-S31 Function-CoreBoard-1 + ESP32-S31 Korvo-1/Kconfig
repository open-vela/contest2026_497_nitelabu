## board/ESP32-S31 Function-CoreBoard-1 + ESP32-S31 Korvo-1/configs/demo-rmt-xts-core/defconfig
```kconfig
#include "../demo-rmt/defconfig"
# xTS common functional tests 1.1.1 through 1.1.3.
CONFIG_ALLOW_MIT_COMPONENTS=y
CONFIG_ARCH_SETJMP_H=y
CONFIG_TLS_LOG2_MAXSTACK=14
CONFIG_LIBC_REGEX=y
CONFIG_TESTING_CMOCKA=y
CONFIG_TESTING_CMOCKA_STACKSIZE=16384
CONFIG_TESTS_TESTSUITES=y
CONFIG_TESTS_TESTSUITES_STACKSIZE=16384
CONFIG_TESTS_TESTSUITES_MOUNT_DIR="/tmp"
CONFIG_CM_MM_TEST=y
CONFIG_CM_SCHED_TEST=y
CONFIG_CM_SYSCALL_TEST=y
CONFIG_PIPES=y
CONFIG_FS_LINKS=y
```

## board/ESP32-S31 Function-CoreBoard-1 + ESP32-S31 Korvo-1/configs/korvo-camera-probe/defconfig
```kconfig
# Korvo-1 + SUB3, camera identification precedes sensor writes.
#include "../korvo-rgb565/defconfig"
CONFIG_INIT_ENTRYPOINT="nsh_main"
CONFIG_ESPRESSIF_I2C0=y
CONFIG_ESPRESSIF_I2C0_SCLPIN=1
CONFIG_ESPRESSIF_I2C0_SDAPIN=0
CONFIG_I2C_DRIVER=y
CONFIG_VIDEO_STREAM=y
CONFIG_SCHED_HPWORK=y
CONFIG_ESP32S31_CAMERA_OV3660=y
CONFIG_ESP32S31_CAMERA_DVP=y
CONFIG_ESP32S31_CAMERA_V4L2=y
CONFIG_ESP32S31_CAMERA_DVP_HRES=640
CONFIG_ESP32S31_CAMERA_DVP_VRES=480
CONFIG_ESP32S31_CAMERA_DVP_XCLK_FREQ=16000000
CONFIG_SYSTEM_I2CTOOL=y
```

## board/ESP32-S31 Function-CoreBoard-1 + ESP32-S31 Korvo-1/configs/xts-flat-bmi160-uorb/defconfig
```kconfig
#include "../xts-flat-rtc/defconfig"

# External BMI160 uORB fixture for original category Sensor framework case.
CONFIG_ESP32S31_XTS_BMI160_UORB=y
CONFIG_ESPRESSIF_I2C0=y
CONFIG_ESPRESSIF_I2C0_SCLPIN=45
CONFIG_ESPRESSIF_I2C0_SDAPIN=46
CONFIG_I2C=y
CONFIG_I2C_DRIVER=y
CONFIG_SENSORS=y
CONFIG_SENSORS_BMI160=y
CONFIG_SENSORS_BMI160_I2C=y
CONFIG_BMI160_I2C_ADDR_68=y
CONFIG_SENSORS_BMI160_UORB=y
CONFIG_USENSOR=y
CONFIG_UORB=y
CONFIG_UORB_LISTENER=y
CONFIG_UORB_STACKSIZE=8192
CONFIG_DEBUG_UORB=y
# CONFIG_ESP32S31_XTS_BMI160 is not set
# CONFIG_SENSORS_BMI160_SPI is not set
# CONFIG_BMI160_I2C_ADDR_69 is not set
```

## board/ESP32-S31 Function-CoreBoard-1 + ESP32-S31 Korvo-1/configs/xts-flat-category-fs-worker/defconfig
```kconfig
#include "../xts-flat-category-fs-large/defconfig"
CONFIG_ESP32S31_FLASH_DIRECT_WORKER=y
CONFIG_FS_LITTLEFS_RANDOM_OVERWRITE_ACCEL=y
```

## board/ESP32-S31 Function-CoreBoard-1 + ESP32-S31 Korvo-1/configs/xts-flat-category-kv/defconfig
```kconfig
#include "../xts-flat-flash/defconfig"

# Original KVDB suite and stability app. Mount scratch storage explicitly.
CONFIG_FS_LITTLEFS=y
CONFIG_FS_LOCK_BUCKET_SIZE=8
CONFIG_TLS_TASK_NELEM=4
CONFIG_UNQLITE=y
CONFIG_KVDB=y
CONFIG_KVDB_SERVER=y
CONFIG_KVDB_UNQLITE=y
CONFIG_KVDB_TEMPORARY_STORAGE=y
CONFIG_KVDB_PERSIST_PATH="/data/persist.db"
CONFIG_KVDB_TEMPORARY_PATH="/tmp/db"
CONFIG_KVDB_STACKSIZE=8192
CONFIG_NET=y
CONFIG_NETDEV_LATEINIT=y
CONFIG_NET_LOCAL=y
CONFIG_NET_LOCAL_STREAM=y
CONFIG_NET_SOCKOPTS=y
CONFIG_EPOLL=y
CONFIG_PIPES=y
CONFIG_TESTS_TESTSUITES=y
CONFIG_CM_KVDB_TEST=y
CONFIG_TESTS_TESTCASES=y
CONFIG_KVDB_TEST=y
CONFIG_KVDB_TEST_STABILITY=y
CONFIG_TESTING_TESTCASES_STACKSIZE=16384
```
