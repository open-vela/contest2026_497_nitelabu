## workspace/openvela-untracked/nuttx/boards/risc-v/esp32s31/esp32s31-core-function-board/configs/korvo-factory-vision/defconfig
```kconfig
# Factory UI with the original dual-core kernel vision service.
#include "../korvo-smp-services/defconfig"
CONFIG_XMSDEMO_FACTORY=m
# CONFIG_XMSDEMO_LAUNCHER is not set
# CONFIG_XMSDEMO_PLATFORM is not set
# CONFIG_XMSDEMO_PLATFORM_MEDIA is not set
# CONFIG_XMSDEMO_LVGLDEMO is not set
# CONFIG_LV_USE_DEMO_WIDGETS is not set
# CONFIG_LV_USE_DEMO_MUSIC is not set
# CONFIG_EXAMPLES_S31FOUNDATION is not set
# CONFIG_FEATURE is not set
# CONFIG_INTERPRETERS_QUICKJS is not set
CONFIG_ESP32S31_PIE=y
CONFIG_ESP32S31_VISION=y
CONFIG_SCHED_KTHREAD_GC=y
CONFIG_ESP32S31_CAMERA_OV3660=y
CONFIG_ESP32S31_CAMERA_DVP=y
CONFIG_ESP32S31_CAMERA_DVP_HRES=640
CONFIG_ESP32S31_CAMERA_DVP_VRES=480
CONFIG_ESP32S31_CAMERA_DVP_XCLK_FREQ=16000000
# CONFIG_ESP32S31_CAMERA_V4L2 is not set
CONFIG_I2C_DRIVER=y
CONFIG_SCHED_HPWORK=y
CONFIG_SCHED_HPWORKSTACKSIZE=4096
CONFIG_LIBM=y
CONFIG_ARCH_HEAP_NPAGES=768
CONFIG_ARCH_DATA_NPAGES=512
CONFIG_ARCH_TEXT_NPAGES=1024
CONFIG_ELF_APP_MAX_FILESIZE=6291456
# Native LVGL decoding of the original transparent PNG resources in the embedded ROM filesystem.
CONFIG_LIB_PNG=y
CONFIG_LV_USE_LIBPNG=y
CONFIG_LV_USE_THEME_SIMPLE=y
CONFIG_LV_FONT_MONTSERRAT_14=y
CONFIG_LV_FONT_MONTSERRAT_18=y
CONFIG_LV_FONT_MONTSERRAT_24=y
CONFIG_LV_FONT_MONTSERRAT_46=y
CONFIG_LIB_ZLIB=y
CONFIG_LV_USE_FS_POSIX=y
CONFIG_LV_FS_POSIX_LETTER=83
CONFIG_LV_FS_POSIX_PATH=""
CONFIG_LV_FS_POSIX_CACHE_SIZE=0
CONFIG_LV_DRAW_SW_DRAW_UNIT_CNT=1
CONFIG_LV_DRAW_BUF_STRIDE_ALIGN=1
CONFIG_LV_DRAW_BUF_ALIGN=4
CONFIG_LV_CACHE_DEF_SIZE=0
CONFIG_LV_IMAGE_HEADER_CACHE_DEF_CNT=48
CONFIG_LV_DECODER_IMG_SIZE_EXPAND=0

# Native MEDIA Capture and Music graphs use bounded 16-bit PCM sessions.
CONFIG_LIB_FFMPEG_CONFIGURATION="--disable-asm --disable-inline-asm --disable-rvv --disable-tx-double --disable-tx-int32 --enable-avcodec --enable-avdevice --enable-avfilter --enable-avformat --enable-swresample --enable-alsa --enable-decoder='aac,mp3float,opus,pcm_s16le' --enable-encoder=pcm_s16le --enable-demuxer='aac,mov,mp3,ogg,wav,pcm_s16le' --enable-muxer=pcm_s16le --enable-parser='aac,mpegaudio,opus' --enable-filter='abufsrc,asubgraph,abuffer,abuffersink,aresample,alsasink,alsasrc,abufsink' --enable-protocol=file,unix --enable-hardcoded-tables"
```

## workspace/openvela-untracked/nuttx/boards/risc-v/esp32s31/esp32s31-core-function-board/configs/wifi-flat/defconfig
```kconfig
# Isolated M-mode Wi-Fi diagnostic; does not mount or seed Flash AppFS.
#include "../nsh/defconfig"
CONFIG_ALLOW_BSD_COMPONENTS=y
CONFIG_ARCH_FPU=y
CONFIG_ARCH_STACKDUMP=y
CONFIG_BOARD_LATE_INITIALIZE=y
CONFIG_BOARD_INITTHREAD_STACKSIZE=8192
CONFIG_CRYPTO_MBEDTLS=y
CONFIG_DEBUG_ASSERTIONS=y
CONFIG_DEBUG_FEATURES=y
CONFIG_DEBUG_NET=y
CONFIG_DEBUG_NET_ERROR=y
CONFIG_DEBUG_WIRELESS=y
CONFIG_DEBUG_WIRELESS_ERROR=y
CONFIG_DEV_URANDOM=y
CONFIG_DRIVERS_IEEE80211=y
CONFIG_DRIVERS_WIRELESS=y
CONFIG_ESPRESSIF_FLASH_MODE_DIO=y
CONFIG_ESPRESSIF_WIFI=y
CONFIG_ESPRESSIF_WIFI_STATION=y
CONFIG_ESPRESSIF_WIFI_STA_11AX=y
# CONFIG_ESPRESSIF_WIFI_ENABLE_WPA3_SAE is not set
# CONFIG_ESPRESSIF_WIFI_ENABLE_WPA3_OWE_STA is not set
# CONFIG_ESPRESSIF_WIFI_ENABLE_SAE_H2E is not set
# CONFIG_ESPRESSIF_WIFI_ENABLE_SAE_PK is not set
CONFIG_EXAMPLES_NETTEST=y
CONFIG_EXAMPLES_NETTEST_SENDSIZE=4096
CONFIG_EXAMPLES_NETTEST_SERVER=y
# CONFIG_EXAMPLES_NETTEST_INIT is not set
CONFIG_FS_TMPFS=y
CONFIG_IDLETHREAD_STACKSIZE=3072
CONFIG_INIT_STACKSIZE=4096
CONFIG_IOB_BUFSIZE=400
CONFIG_IOB_NBUFFERS=96
CONFIG_IOB_NCHAINS=32
CONFIG_IOB_THROTTLE=24
CONFIG_MBEDTLS_HAVE_TIME_DATE=y
CONFIG_MBEDTLS_VERSION="3.6.4"
CONFIG_NETDB_DNSCLIENT=y
CONFIG_NETDB_RESOLVCONF=y
CONFIG_NETDB_RESOLVCONF_PATH="/tmp/resolv.conf"
CONFIG_NETDEV_LATEINIT=y
CONFIG_NETDEV_PHY_IOCTL=y
CONFIG_NETDEV_WIRELESS_IOCTL=y
CONFIG_NET_BROADCAST=y
CONFIG_NET_ETH_PKTSIZE=1514
CONFIG_NET_ICMP_SOCKET=y
CONFIG_NET_SOCKOPTS=y
CONFIG_NET_TCP=y
CONFIG_NET_TCP_DELAYED_ACK=y
CONFIG_NET_TCP_KEEPALIVE=y
CONFIG_NET_TCP_WRITE_BUFFERS=y
CONFIG_NET_UDP=y
CONFIG_NET_UDP_CHECKSUMS=y
CONFIG_NET_UDP_WRITE_BUFFERS=y
CONFIG_NSH_QUOTE=y
# CONFIG_NSH_NETINIT is not set
CONFIG_PTHREAD_MUTEX_TYPES=y
CONFIG_RAM_SIZE=524288
CONFIG_RAM_START=0x2f000000
CONFIG_RAM_VSTART=0x2f000000
CONFIG_READLINE_CMD_HISTORY=y
CONFIG_RR_INTERVAL=20
CONFIG_RTC=y
CONFIG_RTC_DRIVER=y
CONFIG_SCHED_HAVE_PARENT=y
CONFIG_SCHED_LPWORK=y
CONFIG_SCHED_BACKTRACE=y
CONFIG_SIG_DEFAULT=y
CONFIG_SYSTEM_DHCPC_RENEW=y
CONFIG_SYSTEM_NSH_PRIORITY=101
CONFIG_SYSTEM_PING=y
CONFIG_TLS_NELEM=4
CONFIG_TLS_TASK_NELEM=4
CONFIG_WIRELESS=y
CONFIG_WIRELESS_WAPI=y
CONFIG_WIRELESS_WAPI_CMDTOOL=y
CONFIG_WIRELESS_WAPI_INITCONF=y
```

## workspace/openvela-untracked/nuttx/boards/risc-v/esp32s31/esp32s31-core-function-board/configs/xts-flat-usb-adb/defconfig
```kconfig
#include "../xts-flat-rtc/defconfig"

# USB device registration is lazy, initiated by the original adbd application.
# CONFIG_ESPRESSIF_SPIRAM_USER_HEAP is not set
CONFIG_MM_REGIONS=1
CONFIG_USBDEV=y
CONFIG_ESP32S31_USBDEV=y
CONFIG_USBDEV_SELFPOWERED=y
CONFIG_USBDEV_MAXPOWER=0
CONFIG_USBADB=y
CONFIG_LIBUV=y
CONFIG_PTHREAD_MUTEX_TYPES=y
CONFIG_EPOLL=y
CONFIG_PIPES=y
CONFIG_NET=y
CONFIG_NETDEV_LATEINIT=y
CONFIG_NET_LOCAL=y
CONFIG_NET_LOCAL_STREAM=y
CONFIG_NET_SOCKOPTS=y
CONFIG_SYSTEM_ADBD=y
CONFIG_ADBD_USB_SERVER=y
CONFIG_ADBD_USB_BOARDCTL=y
CONFIG_ADBD_STACKSIZE=8192
CONFIG_ADBD_PRODUCT_NAME="ESP32-S31 Function-CoreBoard-1"
CONFIG_ADBD_PRODUCT_MODEL="openvela S31"
CONFIG_TLS_TASK_NELEM=4
CONFIG_SCHED_HAVE_PARENT=y
CONFIG_SCHED_CHILD_STATUS=y
CONFIG_PSEUDOTERM=y
CONFIG_PSEUDOTERM_SUSV1=y
CONFIG_FS_BINFS=y
CONFIG_ADBD_SHELL_SERVICE=y
CONFIG_ADBD_SHELL_SERVICE_CMD="nsh"
CONFIG_ADBD_SHELL_SERVICE_PATH="/bin/nsh"
```

## workspace/tools/esp32c6-i2c-slave/main/Kconfig.projbuild
```kconfig
menu "I2C protocol fixture"

config I2C_SLAVE_SCL_GPIO
    int "I2C slave SCL GPIO"
    range 0 30
    default 4

config I2C_SLAVE_SDA_GPIO
    int "I2C slave SDA GPIO"
    range 0 30
    default 5

config I2C_SLAVE_ADDRESS
    int "I2C slave 7-bit address"
    range 1 127
    default 104

endmenu
```
